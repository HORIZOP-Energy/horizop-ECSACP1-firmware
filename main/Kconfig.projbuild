## main/Kconfig.projbuild
```kconfig
# put here your custom config value
menu "Example Configuration"
config ESP_WIFI_SSID
    string "WiFi SSID"
    default "ooredoo5B1870"
    help
	SSID (network name) for the example to connect to.

config ESP_WIFI_PASSWORD
    string "WiFi Password"
    default "68EAEBE1Tm~62"
    help
	WiFi password (WPA or WPA2) for the example to use.
endmenu
```
